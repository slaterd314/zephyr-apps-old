## Kconfig
```kconfig
# Copyright (c) 2023 Teledatics, Inc.
# All Rights Reserved
#
# This Kconfig file is picked by the Zephyr build system because it is defined
# as the module Kconfig entry point (see zephyr/module.yml). You can browse
# module options by going to Zephyr -> Modules in Kconfig.

rsource "drivers/Kconfig"
rsource "lib/Kconfig"
```

## manifest/west.yml
```yaml
manifest:
  remotes:
    - name: zephyrproject-rtos
      url-base: https://github.com/zephyrproject-rtos
    - name: zephyr-apps
      url-base: https://github.com/slaterd314/zephyr-apps
  defaults:
    remote: zephyr-apps
  projects:
    - name: zephyr
      remote: zephyrproject-rtos
      revision: v3.3.0
      import: true
    - name: kimchi-drone-control
      revision: main
  self:
    path: manifest
    
```
